/**
 * @cliArgs --board "/ti/boards/CC3220SF_LAUNCHXL" --product "simplelink_cc32xx_sdk@4_20_00_07"
 * @versions {"data":"2021010520","timestamp":"2021010520","tool":"1.7.0+1746","templates":null}
 */

/**
 * Import the modules used in this configuration.
 */
const DriverLib      = scripting.addModule("/ti/devices/DriverLib");
const Display        = scripting.addModule("/ti/display/Display");
const Display1       = Display.addInstance();
const Board          = scripting.addModule("/ti/drivers/Board");
const Crypto         = scripting.addModule("/ti/drivers/Crypto");
const Crypto1        = Crypto.addInstance();
const DMA            = scripting.addModule("/ti/drivers/DMA");
const GPIO           = scripting.addModule("/ti/drivers/GPIO");
const GPIO1          = GPIO.addInstance();
const GPIO2          = GPIO.addInstance();
const GPIO3          = GPIO.addInstance();
const GPIO4          = GPIO.addInstance();
const GPIO5          = GPIO.addInstance();
const GPIO6          = GPIO.addInstance();
const GPIO7          = GPIO.addInstance();
const GPIO8          = GPIO.addInstance();
const GPIO9          = GPIO.addInstance();
const GPIO10         = GPIO.addInstance();
const GPIO11         = GPIO.addInstance();
const GPIO12         = GPIO.addInstance();
const GPIO13         = GPIO.addInstance();
const PWM            = scripting.addModule("/ti/drivers/PWM", {}, false);
const PWM1           = PWM.addInstance();
const Power          = scripting.addModule("/ti/drivers/Power");
const SPI            = scripting.addModule("/ti/drivers/SPI");
const Timer          = scripting.addModule("/ti/drivers/Timer");
const Timer1         = Timer.addInstance();
const Timer2         = Timer.addInstance();
const Timer3         = Timer.addInstance();
const UART           = scripting.addModule("/ti/drivers/UART", {}, false);
const UART1          = UART.addInstance();
const Watchdog       = scripting.addModule("/ti/drivers/Watchdog");
const Watchdog1      = Watchdog.addInstance();
const SimpleLinkWifi = scripting.addModule("/ti/drivers/net/wifi/SimpleLinkWifi");
const SlNet          = scripting.addModule("/ti/net/SlNet");
const SlNet1         = SlNet.addInstance();

/**
 * Write custom configuration values to the imported modules.
 */
Display1.$name                          = "CONFIG_Display_0";
Display1.$hardware                      = system.deviceData.board.components.XDS110UART;
Display1.uart.$name                     = "CONFIG_UART_0";
Display1.uart.useDMA                    = true;
Display1.uart.uart.$assign              = "UART0";
Display1.uart.uart.txPin.$assign        = "55";
Display1.uart.uart.rxPin.$assign        = "57";
Display1.uart.uart.txDmaChannel.$assign = "UDMA_CH9";
Display1.uart.uart.rxDmaChannel.$assign = "UDMA_CH8";

Crypto1.$name = "CONFIG_Crypto_0";

GPIO1.$hardware      = system.deviceData.board.components.LED_YELLOW;
GPIO1.outputStrength = "High";
GPIO1.$name          = "CONFIG_GPIO_LED_1";

GPIO2.$hardware      = system.deviceData.board.components.LED_GREEN;
GPIO2.outputStrength = "High";
GPIO2.$name          = "CONFIG_GPIO_LED_2";

GPIO3.$name           = "CONFIG_GPIO_0";
GPIO3.mode            = "Dynamic";
GPIO3.gpioPin.$assign = "boosterpack.24";

GPIO4.$name           = "CONFIG_GPIO_1";
GPIO4.mode            = "Dynamic";
GPIO4.gpioPin.$assign = "boosterpack.2";

GPIO5.$name           = "CONFIG_GPIO_DEBUG_0";
GPIO5.mode            = "Output";
GPIO5.gpioPin.$assign = "boosterpack.26";

GPIO6.$name           = "CONFIG_GPIO_DEBUG_1";
GPIO6.mode            = "Output";
GPIO6.gpioPin.$assign = "boosterpack.27";

GPIO7.mode            = "Output";
GPIO7.$name           = "CONFIG_GPIO_DEBUG_2";
GPIO7.gpioPin.$assign = "boosterpack.30";

GPIO8.$name           = "CONFIG_GPIO_DEBUG_3";
GPIO8.mode            = "Output";
GPIO8.gpioPin.$assign = "boosterpack.8";

GPIO9.$name           = "CONFIG_GPIO_DEBUG_4";
GPIO9.mode            = "Output";
GPIO9.gpioPin.$assign = "boosterpack.28";

GPIO10.$name           = "CONFIG_GPIO_DEBUG_5";
GPIO10.mode            = "Output";
GPIO10.gpioPin.$assign = "boosterpack.4";

GPIO11.$name           = "CONFIG_GPIO_DEBUG_6";
GPIO11.mode            = "Output";
GPIO11.gpioPin.$assign = "boosterpack.19";

GPIO12.$name           = "CONFIG_GPIO_DEBUG_7";
GPIO12.mode            = "Output";
GPIO12.gpioPin.$assign = "boosterpack.5";

GPIO13.$hardware = system.deviceData.board.components.LED_RED;
GPIO13.$name     = "CONFIG_GPIO_LED_0";

PWM1.$name                = "CONFIG_PWM_0";
PWM1.timer.$assign        = "Timer1";
PWM1.timer.pwmPin.$assign = "boosterpack.13";

Power.ioRetentionShutdown = ["GRP_1"];
Power.parkPins.$name      = "ti_drivers_power_PowerCC32XXPins0";

Timer1.$name         = "CONFIG_TIMER_0";
Timer1.timerType     = "32 Bits";
Timer1.timer.$assign = "Timer0";

Timer2.$name     = "CONFIG_TIMER_1";
Timer2.timerType = "32 Bits";

Timer3.$name             = "CONFIG_TIMER_2";
Timer3.interruptPriority = "3";
Timer3.timerType         = "32 Bits";

UART1.$name              = "CONFIG_UART_1";
UART1.dataDirection      = "Receive Only";
UART1.uart.rxPin.$assign = "boosterpack.18";

Watchdog1.$name            = "CONFIG_WATCHDOG_0";
Watchdog1.watchdog.$assign = "WATCHDOG0";

SlNet1.$name  = "CONFIG_SLNET";
SlNet1.ifName = "CC32xx";

/**
 * Pinmux solution for unlocked pins/peripherals. This ensures that minor changes to the automatic solver in a future
 * version of the tool will not impact the pinmux you originally saw.  These lines can be completely deleted in order to
 * re-solve from scratch.
 */
GPIO1.gpioPin.$suggestSolution  = "boosterpack.9";
GPIO2.gpioPin.$suggestSolution  = "boosterpack.10";
GPIO13.gpioPin.$suggestSolution = "boosterpack.29";
Timer2.timer.$suggestSolution   = "Timer3";
Timer3.timer.$suggestSolution   = "Timer2";
UART1.uart.$suggestSolution     = "UART1";
